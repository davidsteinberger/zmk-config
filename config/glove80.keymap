#pragma once

#define ZMK_BASE_LAYER( \
  name, \
  K00, K01, K02, K03, K04,    K05, K06, K07, K08, K09, \
  K10, K11, K12, K13, K14,    K15, K16, K17, K18, K19, \
  K20, K21, K22, K23, K24,    K25, K26, K27, K28, K29, \
  K30, K31, K32, K33, K34,    K35, K36, K37, K38, K39  \
) \
  ZMK_LAYER( \
    name, \
    &kp F1     &kp F2    &kp F3  &kp   F4     &kp F5                                                                            &kp F6    &kp F7    &kp F8    &kp F9     &kp F10      \
    &kp ESC    &kp N1    &kp N2  &kp   N3     &kp N4  &kp N5                                                          &kp N6    &kp N7    &kp N8    &kp N9    &kp N0     &kp BSPC     \
    U_PST      K00       K01     K02   K03    K04                                                                     K05       K06       K07       K08       K09        &kp EQUAL    \
    U_CPY      K10       K11     K12   K13    K14                                                                     K15       K16       K17       K18       K19        &comma_qmark \
    &kp LSHFT  K20       K21     K22   K23    K24     &ctrl_alt  &kp LGUI  &kp LALT    &kp RALT  &kp RGUI  &kp RCTRL  K25       K26       K27       K28       K29        &kp RSHFT    \
    &kp UP     &kp DOWN  U_CPY   U_NP  U_PST          K33        K34       K32         K37       K35       K36        &kp LGUI  AS(LBKT)  AS(RBKT)  &kp LEFT  &kp RIGHT               \
)

#include "zmk-helpers/key-labels/glove80.h"
#include "custom.keymap"

// Alt+Tab swapper, requires PR #1366
ZMK_BEHAVIOR(swapper, tri_state,
  bindings = <&kt LGUI>, <&kp TAB>, <&kt LGUI>;
  timeout-ms = <350>;
  ignored-key-positions = <LF2 LM1 RM1>;
)

ZMK_COMBO(pdot_comma_qmark, &comma_qmark, RB1 RB2, U_BASE U_ALT )
ZMK_COMBO(sk_shift, &sk LSHFT, RH2 RB2, U_BASE U_ALT )
ZMK_COMBO(ip, &ip, LH2 LT2 RM4, U_BASE U_ALT)
ZMK_COMBO(ep, &ep, LH2 LT2 RM3, U_BASE U_ALT)
ZMK_COMBO(iw, &iw, LH2 LT1 RM4, U_BASE U_ALT)
ZMK_COMBO(ew, &ew, LH2 LT1 RM3, U_BASE U_ALT)
ZMK_COMBO(i,  &i, RH2 RB4, U_BASE U_ALT)
ZMK_COMBO(sw, &swapper, LF2, U_BASE U_ALT)
ZMK_COMBO(enter2, &kp ENTER, LF1 LF2, U_BASE U_ALT U_EXTRA)

// workaround for shifted rgb functions not working in zmk
// see https://github.com/manna-harbour/miryoku_zmk?tab=readme-ov-file#global-shift-functions
ZMK_COMBO(rgb_brd, &rgb_ug RGB_BRD, LM1 RT3, U_MEDIA)
ZMK_COMBO(rgb_sai, &rgb_ug RGB_SAD, LM1 RT2, U_MEDIA)

