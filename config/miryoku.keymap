#include "zmk-helpers/helper.h"

#undef COMBO_TERM
#define COMBO_TERM 100

ZMK_BEHAVIOR(apos_under, mod_morph, 
  bindings = <&shifted_kp UNDER APOS>, <&kp UNDER>;
  mods = <(MOD_LSFT|MOD_RSFT)>;
)

ZMK_BEHAVIOR(comma_qmark, mod_morph, 
  bindings = <&shifted_kp QMARK COMMA>, <&kp QMARK>;
  mods = <(MOD_LSFT|MOD_RSFT)>;
)

ZMK_BEHAVIOR(dot_gt, mod_morph, 
  bindings = <&shifted_kp GT DOT>, <&kp GT>;
  mods = <(MOD_LSFT|MOD_RSFT)>;
)

ZMK_BEHAVIOR(minus_dqt, mod_morph, 
  bindings = <&kp MINUS>, <&kp DQT>;
  mods = <(MOD_LSFT|MOD_RSFT)>;
)

ZMK_BEHAVIOR(slash_lt, mod_morph, 
  bindings = <&shifted_kp LT SLASH>, <&kp LT>;
  mods = <(MOD_LSFT|MOD_RSFT)>;
)

ZMK_BEHAVIOR(ht_minus_dqt, hold_tap,
  bindings = <&kp>, <&minus_dqt>;
  flavor = "tap-preferred";
  tapping-term-ms = <200>;
)

ZMK_BEHAVIOR(skq, sticky_key,
  bindings = <&kp>;
  release-after-ms = <300>;
  quick-release;
  ignore-modifiers;
)

ZMK_BEHAVIOR(gt, macro,
    bindings = <&kp GT>;
)

ZMK_BEHAVIOR(shifted, macro_one_param,
  bindings =
    <&macro_press &kp LSHFT>,
    <&macro_param_1to1 &macro_tap &kp MACRO_PLACEHOLDER>,
    <&macro_release &kp LSHFT>;
)

ZMK_BEHAVIOR(shifted_kp, hold_tap,
  tapping-term-ms = <300>;
  quick-tap-ms = <0>;
  flavor = "tap-preferred";
  bindings = <&shifted>, <&kp>;
)

ZMK_BEHAVIOR(kp_sticky, hold_tap,
  tapping-term-ms = <300>;
  quick-tap-ms = <0>;
  flavor = "tap-preferred";
  bindings = <&kp>, <&sk>;
)

ZMK_BEHAVIOR(copy_paste, tap_dance,
  tapping-term-ms = <200>;
  bindings = <U_CPY>, <U_PST>;
)

ZMK_BEHAVIOR(as, macro_one_param,
  bindings =
      <&macro_press>,
      <&macro_param_1to1>,
      <&macro_param_1to2>,
      <&shifted_kp MACRO_PLACEHOLDER MACRO_PLACEHOLDER>,
      <&macro_pause_for_release>,
      <&macro_release>,
      <&macro_param_1to1>,
      <&macro_param_1to2>,
      <&shifted_kp MACRO_PLACEHOLDER MACRO_PLACEHOLDER>;
)

ZMK_BEHAVIOR(tripple_grave, macro,
  bindings = 
    <&macro_release &kp LSHFT>,
    <&macro_release &kp LALT>,
    <&macro_tap &kp GRAVE &kp GRAVE &kp GRAVE>;
)

ZMK_BEHAVIOR(tg, mod_morph,
  bindings = <&gresc>, <&tripple_grave>;
  mods = <(MOD_LALT)>;
)

// Alt+Tab swapper, requires PR #1366
ZMK_BEHAVIOR(swapper, tri_state,
    bindings = <&kt LGUI>, <&kp TAB>, <&kt LGUI>;
    timeout-ms = <500>;
    ignored-key-positions = <LB1 LB2 LB3 LM1 RM1>;
)

ZMK_BEHAVIOR(dot_space, macro,
    bindings = <&kp DOT &kp SPACE &sk LSHFT>;
)

ZMK_BEHAVIOR(ip, macro,
    bindings = <&sk LSHFT &kp D &kp A &kp V &kp I &kp D &kp SPACE &sk LSHFT &kp S &kp T &kp E &kp I &kp N &kp B &kp E &kp R &kp G &kp E &kp R>;
)

ZMK_BEHAVIOR(ep, macro,
    bindings = <&kp M &kp A &kp I &kp L &kp DOT &kp S &kp T &kp E &kp I &kp N &kp B &kp E &kp R &kp G &kp E &kp R &kp AT &kp G &kp M &kp A &kp I &kp L &kp DOT &kp C &kp O &kp M>;
)

ZMK_BEHAVIOR(iw, macro,
    bindings = <&kp KP_N1 &kp KP_N0 &kp KP_N5 &kp KP_N0 &kp KP_N4 &kp KP_N2 &kp KP_N6 &kp KP_N9 &kp KP_N7>;
)

ZMK_BEHAVIOR(ew, macro,
    bindings = < &kp D &kp A &kp V &kp I &kp D &kp DOT &kp S &kp T &kp E &kp I &kp N &kp B &kp E &kp R &kp G &kp E &kp R &kp AT &kp I &kp N &kp N &kp I &kp O &kp DOT &kp C &kp O &kp M>;
)

ZMK_BEHAVIOR(tmux, macro,
    bindings = <&sk RCTRL &kp SPACE>;
)

ZMK_BEHAVIOR(ctrl_alt, macro,
    bindings = <&macro_press &kp LCTRL &kp LALT>
    , <&macro_pause_for_release>
    , <&macro_release &kp LCTRL &kp LALT>;
)

ZMK_BEHAVIOR(i, macro,
    bindings = <&kp LS(I)>;
)

ZMK_BEHAVIOR(equal_left, macro,
    bindings = <&kp LT &kp EQUAL>;
)
ZMK_BEHAVIOR(equal_right, macro,
    bindings = <&kp EQUAL &kp GT>;
)
ZMK_BEHAVIOR(par_brc, macro,
    bindings = <&macro_release &kp LSHFT>
    , <&macro_release &kp LALT>
    , <&macro_tap &kp LPAR &kp LBRC &kp RBRC &kp RPAR &kp LEFT &kp LEFT>;
)
ZMK_BEHAVIOR(brc, macro,
    bindings = <&macro_release &kp LSHFT>
    , <&macro_release &kp LALT>
    , <&macro_tap &kp LBRC &kp RBRC &kp LEFT>;
)
ZMK_BEHAVIOR(bkt, macro,
    bindings = <&macro_release &kp LSHFT>
    , <&macro_release &kp LALT>
    , <&macro_tap &kp LBKT &kp RBKT &kp LEFT>;
)
ZMK_BEHAVIOR(s_brc_bkt, mod_morph,
    bindings = <&brc>, <&bkt>;
    mods = <(MOD_LSFT|MOD_RSFT)>;
)
ZMK_BEHAVIOR(a_brc_bkt, mod_morph,
    bindings = <&s_brc_bkt>, <&par_brc>;
    mods = <(MOD_LALT)>;
)
ZMK_BEHAVIOR(s_par_open_close, mod_morph,
    bindings = <&par_open_close>, <&kp LPAR>;
    mods = <(MOD_LSFT)>;
)
ZMK_BEHAVIOR(a_par_open_close, mod_morph,
    bindings = <&s_par_open_close>, <&kp RPAR>;
    mods = <(MOD_LALT)>;
)
ZMK_BEHAVIOR(par_open_close, macro,
    bindings = <&macro_release &kp LSHFT>
    , <&macro_release &kp LALT>
    , <&macro_tap &kp LPAR &kp RPAR>;
)
ZMK_BEHAVIOR(s_par_esc, mod_morph,
    bindings = <&kp LPAR>, <&kp ESC>;
    mods = <(MOD_LSFT)>;
)
ZMK_BEHAVIOR(mo_kp, hold_tap,
  tapping-term-ms = <200>;
  quick-tap-ms = <0>;
  flavor = "tap-preferred";
  bindings = <&mo>, <&kp>;
)

ZMK_ADAPTIVE_KEY(
  ak_tab,
  bindings = <&mo_kp U_MOUSE TAB>;
  eu { trigger-keys = <E>; max-prior-idle-ms = <300>; bindings = <&kp U>; };
  ue { trigger-keys = <U>; max-prior-idle-ms = <300>; bindings = <&kp E>; };
  rl { trigger-keys = <R>; max-prior-idle-ms = <300>; bindings = <&kp L>; };
  /* ld { trigger-keys = <L>; max-prior-idle-ms = <300>; bindings = <&kp D>; }; */
  sc { trigger-keys = <S>; max-prior-idle-ms = <500>; bindings = <&kp C &kp H>; };
  ion { trigger-keys = <I>; max-prior-idle-ms = <300>; bindings = <&kp O &kp N>; };
  ph { trigger-keys = <P>; max-prior-idle-ms = <300>; bindings = <&kp H>; };
)

ZMK_ADAPTIVE_KEY(
  ak_sc,
  bindings = <&mo_kp U_NAV SPACE>;
  dot_sc { trigger-keys = <DOT>; max-prior-idle-ms = <300>; bindings = <&kp SPACE &sk LSHFT>; };
)

ZMK_COMBO(enter, &kp ENTER, LB3 LB2 LB1, U_BASE U_ALT U_EXTRA)
ZMK_COMBO(esc,  &tg, LB2 LB1, U_BASE U_ALT U_EXTRA)
/* ZMK_COMBO(equals, &kp EQUAL, RB0 RB1, U_BASE U_ALT U_EXTRA) */
ZMK_COMBO(par_open_close, &a_par_open_close, LB2 LB3, U_BASE U_ALT U_EXTRA, 300)
ZMK_COMBO(semi, &as SEMI, RB2 RB3, U_BASE U_ALT U_EXTRA, 300)
ZMK_COMBO(s_brc_bkt, &a_brc_bkt, LB1 LB0, U_BASE U_ALT U_EXTRA)
ZMK_COMBO(gt, &equal_right, RB1 RB3, U_BASE U_ALT U_EXTRA, 300)
ZMK_COMBO(lt, &equal_left, RB1 RB4, U_BASE U_ALT U_EXTRA, 300)

#define QUICK_TAP_MS 250
#define KEYS_L LT0 LT1 LT2 LT3 LT4 LT5 LM0 LM1 LM2 LM3 LM4 LM5 LB0 LB1 LB2 LB3 LB4 LB5
#define KEYS_R RT0 RT1 RT2 RT3 RT4 RT5 RM0 RM1 RM2 RM3 RM4 RM5 RB0 RB1 RB2 RB3 RB4 RB5
#ifndef LH2
#define THUMBS LH1 LH0 RH0 RH1         // Thumbs on 34 keys.
#else
#define THUMBS LH2 LH1 LH0 RH0 RH1 RH2 // Thumbs on 36+ keys.
#endif
#define MAKE_HRM(NAME, HOLD, TAP, TRIGGER_POS)                                 \
  ZMK_HOLD_TAP(NAME, bindings = <HOLD>, <TAP>; flavor = "balanced";            \
               tapping-term-ms = <280>; quick-tap-ms = <QUICK_TAP_MS>;         \
               require-prior-idle-ms = <25>; hold-trigger-on-release;         \
               hold-trigger-key-positions = <TRIGGER_POS>;)

MAKE_HRM(hml, &kp, &kp, KEYS_R THUMBS) // Left-hand HRMs.
MAKE_HRM(hmr, &kp, &kp, KEYS_L THUMBS) // Right-hand HRMs.

// Hack: Make HRM combos tap-only (cf, ZMK issue #544).
#define ZMK_COMBO_8(NAME, TAP, POS, LAYERS, COMBO_MS, IDLE_MS, HOLD, SIDE)     \
  MAKE_HRM(hm_combo_##NAME, &kp, TAP, SIDE THUMBS)                             \
  ZMK_COMBO_6(NAME, &hm_combo_##NAME HOLD 0, POS, LAYERS, COMBO_MS, IDLE_MS)
