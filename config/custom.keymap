#include <behaviors.dtsi>
#include <dt-bindings/zmk/pointing.h>
#include <dt-bindings/zmk/outputs.h>
#include <dt-bindings/zmk/ext_power.h>
#include <dt-bindings/zmk/keys.h>
#include <dt-bindings/zmk/bt.h>
#include <dt-bindings/zmk/rgb.h>

#include "zmk-helpers/helper.h"

#define U_BASE   0
#define U_ALT    1
#define U_EXTRA  2
#define U_TAP    3
#define U_BUTTON 4
#define U_NAV    5
#define U_MOUSE  6
#define U_MEDIA  7
#define U_NUM    8
#define U_SYM    9
#define U_FUN    10

#define U_NP &none // key is not present
#define U_NA &none // present but not available for use
#define U_NU &none // available but not used

#define U_RDO &kp LS(LG(Z))
#define U_PST &kp LG(V)
#define U_CPY &kp LG(C)
#define U_CUT &kp LG(X)
#define U_UND &kp LG(Z)

#define U_BTN1 &mkp LCLK
#define U_BTN2 &mkp RCLK
#define U_BTN3 &mkp MCLK
#define U_MS_U &mmv MOVE_UP
#define U_MS_D &mmv MOVE_DOWN
#define U_MS_L &mmv MOVE_LEFT
#define U_MS_R &mmv MOVE_RIGHT
#define U_WH_U &msc SCRL_UP
#define U_WH_D &msc SCRL_DOWN
#define U_WH_L &msc SCRL_LEFT
#define U_WH_R &msc SCRL_RIGHT

#define U_BOOT &u_bootloader

#define U_RGB_TOG &rgb_ug RGB_TOG
#define U_RGB_EFF &rgb_ug RGB_EFF
#define U_RGB_HUI &rgb_ug RGB_HUI
#define U_RGB_SAI &rgb_ug RGB_SAI
#define U_RGB_BRI &rgb_ug RGB_BRI
#define U_EP_TOG &ext_power EP_TOG

#define AS(keycode) &as keycode
#define RALT_MINUS_DQT &ht_minus_dqt RALT 0
/* #define U_MT(MOD, TAP) &mt MOD TAP */
#define U_LT(LAYER, TAP) &lt LAYER TAP
#define U_MTL(mod, keycode) &hml mod keycode
#define U_MTL_f(mod, keycode) &hml_f mod keycode
#define U_MTR(mod, keycode) &hmr mod keycode
#define U_MTR_f(mod, keycode) &hmr_f mod keycode

#undef COMBO_TERM
#define COMBO_TERM 100

// HMR definitions
#define QUICK_TAP_MS 175

#ifdef LM5
#ifdef LN5
#ifdef LF3
#define KEYS_L LT0 LT1 LT2 LT3 LT4 LT5 LM0 LM1 LM2 LM3 LM4 LM5 LB0 LB1 LB2 LB3 LB4 LB5 LN0 LN1 LN2 LN3 LN4 LN5 LF1 LF2 LF3
#else
#define KEYS_L LT0 LT1 LT2 LT3 LT4 LT5 LM0 LM1 LM2 LM3 LM4 LM5 LB0 LB1 LB2 LB3 LB4 LB5 LN0 LN1 LN2 LN3 LN4 LN5
#endif
#else
#define KEYS_L LT0 LT1 LT2 LT3 LT4 LT5 LM0 LM1 LM2 LM3 LM4 LM5 LB0 LB1 LB2 LB3 LB4 LB5
#endif
#else
#define KEYS_L LT0 LT1 LT2 LT3 LT4 LM0 LM1 LM2 LM3 LM4 LB0 LB1 LB2 LB3 LB4
#endif

#ifdef LM5
#ifdef LN5
#ifdef RF3
#define KEYS_R RT0 RT1 RT2 RT3 RT4 RT5 RM0 RM1 RM2 RM3 RM4 RM5 RB0 RB1 RB2 RB3 RB4 RB5 RN0 RN1 RN2 RN3 RN4 RN5 RF1 RF2 RF3
#else
#define KEYS_R RT0 RT1 RT2 RT3 RT4 RT5 RM0 RM1 RM2 RM3 RM4 RM5 RB0 RB1 RB2 RB3 RB4 RB5 RN0 RN1 RN2 RN3 RN4 RN5
#endif
#else
#define KEYS_R RT0 RT1 RT2 RT3 RT4 RT5 RM0 RM1 RM2 RM3 RM4 RM5 RB0 RB1 RB2 RB3 RB4 RB5
#endif
#else
#define KEYS_R RT0 RT1 RT2 RT3 RT4 RM0 RM1 RM2 RM3 RM4 RB0 RB1 RB2 RB3 RB4
#endif

#ifndef LH2
#define THUMBS LH1 LH0 RH0 RH1         // Thumbs on 34 keys.
#else
#define THUMBS LH2 LH1 LH0 RH0 RH1 RH2 // Thumbs on 36+ keys.
#endif
#define MAKE_HRM(NAME, HOLD, TAP, TRIGGER_POS, RPI_MS)                         \
  ZMK_HOLD_TAP(NAME, bindings = <HOLD>, <TAP>; flavor = "balanced";    \
               tapping-term-ms = <280>; quick-tap-ms = <QUICK_TAP_MS>; \
               require-prior-idle-ms = <RPI_MS>; hold-trigger-on-release;  \
               hold-trigger-key-positions = <TRIGGER_POS>;)

MAKE_HRM(hml, &kp, &kp, KEYS_R THUMBS, 150) // Left-hand HRMs.
MAKE_HRM(hml_f, &kp, &kp, KEYS_R THUMBS, 0) // Left-hand HRMs.
MAKE_HRM(hmr, &kp, &kp, KEYS_L THUMBS, 150) // Right-hand HRMs.
MAKE_HRM(hmr_f, &kp, &kp, KEYS_L THUMBS, 0) // Right-hand HRMs.

// Hack: Make HRM combos tap-only (cf, ZMK issue #544).
#define ZMK_COMBO_8(NAME, TAP, POS, LAYERS, COMBO_MS, IDLE_MS, HOLD, SIDE)   \
  MAKE_HRM(hm_combo_##NAME, &kp, TAP, SIDE THUMBS, 150)                           \
  ZMK_COMBO_6(NAME, &hm_combo_##NAME HOLD 0, POS, LAYERS, COMBO_MS, IDLE_MS)


// double tap layer switches
ZMK_BEHAVIOR(u_to_U_TAP, tap_dance,
  tapping-term-ms = <200>;
  bindings = <&none>, <&to U_TAP>;
)
ZMK_BEHAVIOR(u_to_U_EXTRA, tap_dance,
  tapping-term-ms = <200>;
  bindings = <&none>, <&to U_EXTRA>;
)
ZMK_BEHAVIOR(u_to_U_BASE, tap_dance,
  tapping-term-ms = <200>;
  bindings = <&none>, <&to U_BASE>;
)
ZMK_BEHAVIOR(u_to_U_ALT, tap_dance,
  tapping-term-ms = <200>;
  bindings = <&none>, <&to U_ALT>;
)
ZMK_BEHAVIOR(u_to_U_NUM, tap_dance,
tapping-term-ms = <200>;
bindings = <&none>, <&to U_NUM>;
)
ZMK_BEHAVIOR(u_to_U_NAV, tap_dance,
  tapping-term-ms = <200>;
  bindings = <&none>, <&to U_NAV>;
)
ZMK_BEHAVIOR(u_to_U_MOUSE, tap_dance,
  tapping-term-ms = <200>;
  bindings = <&none>, <&to U_MOUSE>;
)
ZMK_BEHAVIOR(u_to_U_SYM, tap_dance,
  tapping-term-ms = <200>;
  bindings = <&none>, <&to U_SYM>;
)
ZMK_BEHAVIOR(u_bootloader, tap_dance,
  tapping-term-ms = <200>;
  bindings = <&none>, <&bootloader>;
)
ZMK_BEHAVIOR(u_to_U_FUN, tap_dance,
  tapping-term-ms = <200>;
  bindings = <&none>, <&to U_FUN>;
)
ZMK_BEHAVIOR(u_to_U_MEDIA, tap_dance,
  tapping-term-ms = <200>;
  bindings = <&none>, <&to U_MEDIA>;
)



// bluetooth shift functions
ZMK_BEHAVIOR(u_bt_sel_0, mod_morph, 
  bindings = <&bt BT_SEL 0>, <&bt BT_SEL 0 &bt BT_CLR>;
  mods = <(MOD_LSFT|MOD_RSFT)>;
)
ZMK_BEHAVIOR(u_bt_sel_1, mod_morph, 
  bindings = <&bt BT_SEL 1>, <&bt BT_SEL 1 &bt BT_CLR>;
  mods = <(MOD_LSFT|MOD_RSFT)>;
)
ZMK_BEHAVIOR(u_bt_sel_2, mod_morph, 
  bindings = <&bt BT_SEL 2>, <&bt BT_SEL 2 &bt BT_CLR>;
  mods = <(MOD_LSFT|MOD_RSFT)>;
)
ZMK_BEHAVIOR(u_bt_sel_3, mod_morph, 
  bindings = <&bt BT_SEL 3>, <&bt BT_SEL 3 &bt BT_CLR>;
  mods = <(MOD_LSFT|MOD_RSFT)>;
)
ZMK_BEHAVIOR(u_bt_sel_4, mod_morph, 
  bindings = <&bt BT_SEL 4>, <&bt BT_SEL 4 &bt BT_CLR>;
  mods = <(MOD_LSFT|MOD_RSFT)>;
)
ZMK_BEHAVIOR(u_out_tog, mod_morph, 
  bindings = <&out OUT_TOG>, <&out OUT_USB>;
  mods = <(MOD_LSFT|MOD_RSFT)>;
)


// caps word shift function
ZMK_BEHAVIOR(caps, mod_morph, 
  bindings = <&caps_word>, <&kp CAPS>;
  mods = <(MOD_LSFT|MOD_RSFT)>;
)

// rgb shift functions
ZMK_BEHAVIOR(u_rgb_tog, mod_morph, 
  bindings = <&rgb_ug RGB_TOG>, <&rgb_ug RGB_OFF>;
  mods = <(MOD_LSFT|MOD_RSFT)>;
)
ZMK_BEHAVIOR(u_rgb_eff, mod_morph, 
  bindings = <&rgb_ug RGB_EFF>, <&rgb_ug RGB_EFR>;
  mods = <(MOD_LSFT|MOD_RSFT)>;
)
ZMK_BEHAVIOR(u_rgb_hui, mod_morph, 
  bindings = <&rgb_ug RGB_HUI>, <&rgb_ug RGB_HUD>;
  mods = <(MOD_LSFT|MOD_RSFT)>;
)
ZMK_BEHAVIOR(u_rgb_sai, mod_morph, 
  bindings = <&rgb_ug RGB_SAI>, <&rgb_ug RGB_SAD>;
  mods = <(MOD_LSFT|MOD_RSFT)>;
)
ZMK_BEHAVIOR(u_rgb_bri, mod_morph, 
  bindings = <&rgb_ug RGB_BRI>, <&rgb_ug RGB_BRD>;
  mods = <(MOD_LSFT|MOD_RSFT)>;
)
ZMK_BEHAVIOR(u_ep_tog, mod_morph, 
  bindings = <&ext_power EP_TOG>, <&ext_power EP_OFF>;
  mods = <(MOD_LSFT|MOD_RSFT)>;
)

ZMK_BEHAVIOR(apos_under, mod_morph, 
  bindings = <&shifted_kp UNDER APOS>, <&kp UNDER>;
  mods = <(MOD_LSFT|MOD_RSFT)>;
)

ZMK_BEHAVIOR(comma_qmark, mod_morph, 
  bindings = <&shifted_kp QMARK COMMA>, <&kp QMARK>;
  mods = <(MOD_LSFT|MOD_RSFT)>;
)

ZMK_BEHAVIOR(dot_gt, mod_morph, 
  bindings = <&shifted_kp GT DOT>, <&kp GT>;
  mods = <(MOD_LSFT|MOD_RSFT)>;
)

ZMK_BEHAVIOR(minus_dqt, mod_morph, 
  bindings = <&kp MINUS>, <&kp DQT>;
  mods = <(MOD_LSFT|MOD_RSFT)>;
)

ZMK_BEHAVIOR(slash_lt, mod_morph, 
  bindings = <&shifted_kp LT SLASH>, <&kp LT>;
  mods = <(MOD_LSFT|MOD_RSFT)>;
)

ZMK_BEHAVIOR(ht_minus_dqt, hold_tap,
  bindings = <&kp>, <&minus_dqt>;
  flavor = "tap-preferred";
  tapping-term-ms = <200>;
)

ZMK_BEHAVIOR(skq, sticky_key,
  bindings = <&kp>;
  release-after-ms = <300>;
  quick-release;
  ignore-modifiers;
)

ZMK_BEHAVIOR(gt, macro,
  bindings = <&kp GT>;
)

ZMK_BEHAVIOR(shifted, macro_one_param,
  bindings =
    <&macro_press &kp LSHFT>,
    <&macro_param_1to1 &macro_tap &kp MACRO_PLACEHOLDER>,
    <&macro_release &kp LSHFT>;
)

ZMK_BEHAVIOR(shifted_kp, hold_tap,
  tapping-term-ms = <300>;
  quick-tap-ms = <0>;
  flavor = "tap-preferred";
  bindings = <&shifted>, <&kp>;
)

ZMK_BEHAVIOR(kp_sticky, hold_tap,
  tapping-term-ms = <300>;
  quick-tap-ms = <0>;
  flavor = "tap-preferred";
  bindings = <&kp>, <&sk>;
)

/* ZMK_BEHAVIOR(copy_paste, tap_dance, */
/*   tapping-term-ms = <200>; */
/*   bindings = <U_CPY>, <U_PST>; */
/* ) */

ZMK_BEHAVIOR(as, macro_one_param,
  bindings =
      <&macro_press>,
      <&macro_param_1to1>,
      <&macro_param_1to2>,
      <&shifted_kp MACRO_PLACEHOLDER MACRO_PLACEHOLDER>,
      <&macro_pause_for_release>,
      <&macro_release>,
      <&macro_param_1to1>,
      <&macro_param_1to2>,
      <&shifted_kp MACRO_PLACEHOLDER MACRO_PLACEHOLDER>;
)

ZMK_BEHAVIOR(tripple_grave, macro,
  bindings = 
    <&macro_release &kp LSHFT>,
    <&macro_release &kp LALT>,
    <&macro_tap &kp GRAVE &kp GRAVE &kp GRAVE>;
)

ZMK_BEHAVIOR(tg_inner, mod_morph,
  bindings = <&gresc>, <&tripple_grave>;
  mods = <(MOD_LALT)>;
)

ZMK_BEHAVIOR(tg, mod_morph,
  bindings = <&tg_inner>, <&kp LG(ESC)>;
  mods = <(MOD_LGUI)>;
)

ZMK_BEHAVIOR(dot_space, macro,
  bindings = <&kp DOT &kp SPACE &sk LSHFT>;
)

ZMK_BEHAVIOR(ip, macro,
  bindings = <&sk LSHFT &kp D &kp A &kp V &kp I &kp D &kp SPACE &sk LSHFT &kp S &kp T &kp E &kp I &kp N &kp B &kp E &kp R &kp G &kp E &kp R>;
)

ZMK_BEHAVIOR(ep, macro,
  bindings = <&kp M &kp A &kp I &kp L &kp DOT &kp S &kp T &kp E &kp I &kp N &kp B &kp E &kp R &kp G &kp E &kp R &kp AT &kp G &kp M &kp A &kp I &kp L &kp DOT &kp C &kp O &kp M>;
)

ZMK_BEHAVIOR(iw, macro,
  bindings = <&kp KP_N1 &kp KP_N0 &kp KP_N5 &kp KP_N0 &kp KP_N4 &kp KP_N2 &kp KP_N6 &kp KP_N9 &kp KP_N7>;
)

ZMK_BEHAVIOR(ew, macro,
  bindings = < &kp D &kp A &kp V &kp I &kp D &kp DOT &kp S &kp T &kp E &kp I &kp N &kp B &kp E &kp R &kp G &kp E &kp R &kp AT &kp I &kp N &kp N &kp I &kp O &kp DOT &kp C &kp O &kp M>;
)

ZMK_BEHAVIOR(tmux, macro,
  bindings = <&sk RCTRL &kp SPACE>;
)

ZMK_BEHAVIOR(ctrl_alt, macro,
  bindings =
    <&macro_press &kp LCTRL &kp LALT>,
    <&macro_pause_for_release>,
    <&macro_release &kp LCTRL &kp LALT>;
)

ZMK_BEHAVIOR(i, macro,
  bindings = <&kp LS(I)>;
)

ZMK_BEHAVIOR(equal_left, macro,
  bindings = <&kp LT &kp EQUAL>;
)
ZMK_BEHAVIOR(equal_right, macro,
  bindings = <&kp EQUAL &kp GT>;
)
ZMK_BEHAVIOR(par_brc, macro,
  bindings = 
    <&macro_release &kp LSHFT>,
    <&macro_release &kp LALT>,
    <&macro_tap &kp LPAR &kp LBRC &kp RBRC &kp RPAR &kp LEFT &kp LEFT>;
)
ZMK_BEHAVIOR(brc, macro,
  bindings = 
    <&macro_release &kp LSHFT>,
    <&macro_release &kp LALT>,
    <&macro_tap &kp LBRC &kp RBRC &kp LEFT>;
)
ZMK_BEHAVIOR(bkt, macro,
  bindings = 
    <&macro_release &kp LSHFT>,
    <&macro_release &kp LALT>,
    <&macro_tap &kp LBKT &kp RBKT &kp LEFT>;
)
ZMK_BEHAVIOR(s_brc_bkt, mod_morph,
  bindings = <&brc>, <&bkt>;
  mods = <(MOD_LSFT|MOD_RSFT)>;
)
ZMK_BEHAVIOR(a_brc_bkt, mod_morph,
  bindings = <&s_brc_bkt>, <&par_brc>;
  mods = <(MOD_LALT)>;
)
ZMK_BEHAVIOR(s_par_open_close, mod_morph,
  bindings = <&par_open_close>, <&kp LPAR>;
  mods = <(MOD_LSFT)>;
)
ZMK_BEHAVIOR(a_par_open_close, mod_morph,
  bindings = <&s_par_open_close>, <&kp RPAR>;
  mods = <(MOD_LALT)>;
)
ZMK_BEHAVIOR(par_open_close, macro,
  bindings = <&macro_release &kp LSHFT>
  , <&macro_release &kp LALT>
  , <&macro_tap &kp LPAR &kp RPAR>;
)
ZMK_BEHAVIOR(s_par_esc, mod_morph,
  bindings = <&kp LPAR>, <&kp ESC>;
  mods = <(MOD_LSFT)>;
)
ZMK_BEHAVIOR(mo_kp, hold_tap,
  tapping-term-ms = <200>;
  quick-tap-ms = <0>;
  flavor = "tap-preferred";
  bindings = <&mo>, <&kp>;
)

ZMK_ADAPTIVE_KEY(
  ak_tab,
  bindings = <&mo_kp U_MOUSE TAB>;
  eu { trigger-keys = <E>; max-prior-idle-ms = <300>; bindings = <&kp U>; };
  ue { trigger-keys = <U>; max-prior-idle-ms = <300>; bindings = <&kp E>; };
  rl { trigger-keys = <R>; max-prior-idle-ms = <300>; bindings = <&kp L>; };
  sc { trigger-keys = <S>; max-prior-idle-ms = <500>; bindings = <&kp C &kp H>; };
  ion { trigger-keys = <I>; max-prior-idle-ms = <300>; bindings = <&kp O &kp N>; };
  ph { trigger-keys = <P>; max-prior-idle-ms = <300>; bindings = <&kp H>; };
)

ZMK_ADAPTIVE_KEY(
  ak_sc,
  bindings = <&mo_kp U_NAV SPACE>;
  dot_sc { trigger-keys = <DOT>; max-prior-idle-ms = <300>; strict-modifiers; bindings = <&kp SPACE &sk LSHFT>; };
)

ZMK_COMBO(enter, &kp ENTER, LB3 LB2 LB1, U_BASE U_ALT U_EXTRA)
/* ZMK_COMBO(del, &kp DEL, LT1 LT2 LT3, U_BASE U_ALT U_EXTRA) */
ZMK_COMBO(esc,  &tg, LB2 LB1, U_BASE U_ALT U_EXTRA)
ZMK_COMBO(par_open_close, &a_par_open_close, LB2 LB3, U_BASE U_ALT U_EXTRA, 300)
ZMK_COMBO(semi, &as SEMI, RB2 RB3, U_BASE U_ALT U_EXTRA, 300)
ZMK_COMBO(s_brc_bkt, &a_brc_bkt, LB1 LB0, U_BASE U_ALT U_EXTRA)
ZMK_COMBO(gt, &equal_right, RB1 RB3, U_BASE U_ALT U_EXTRA, 300)
ZMK_COMBO(lt, &equal_left, RB1 RB4, U_BASE U_ALT U_EXTRA, 300)




ZMK_BASE_LAYER(U_BASE,
  &kp B,             &kp L,           &kp D,              &kp W,            &kp Z,                  &apos_under,      &kp F,              &kp O,            &kp U,          &kp J,          \
  U_MTL(LGUI, N),    U_MTL(LALT, R),  U_MTL(LCTL, T),     U_MTL_f(LSHFT,S), U_MTL(LGUI, G),         U_MTR(LGUI, Y),   U_MTR_f(LSHIFT, H), U_MTR(LCTL, A),   U_MTR(LALT, E), U_MTR(LGUI, I), \
  U_LT(U_BUTTON, Q), U_MTL_f(RALT, X),  &kp M,              &kp C,            &kp V,                  &kp K,            &kp P,              &dot_gt,          RALT_MINUS_DQT, &slash_lt ,     \
  U_NP,              U_NP,            U_LT(U_MEDIA, ESC), &lt U_NAV SPACE,  U_LT(U_MOUSE, TAB),     U_LT(U_SYM, RET), U_LT(U_NUM, BSPC),  U_LT(U_FUN, DEL), U_NP,           U_NP
)

ZMK_BASE_LAYER(U_ALT,
  &kp B,             &kp L,           &kp D,              &kp W,            &kp Z,                  &apos_under,       &kp F,              &kp O,            &kp U,          &kp J,          \
  U_MTL(LGUI, N),    U_MTL(LALT, R),  U_MTL(LCTL, T),     U_MTL_f(LSHFT,S), U_MTL(LGUI, G),         U_MTR(LGUI, Y),    U_MTR_f(LSHIFT, H), U_MTR(LCTL, A),   U_MTR(LALT, E), U_MTR(LGUI, I), \
  U_LT(U_BUTTON, Q), U_MTL_f(RALT, X),  &kp M,              &kp C,            &kp V,                  &kp K,             &kp P,              &dot_gt,          RALT_MINUS_DQT, &slash_lt ,     \
  U_NP,              U_NP,            U_LT(U_MEDIA, ESC), &ak_sc,           &ak_tab,                U_LT(U_SYM, RET),  U_LT(U_NUM, BSPC),  U_LT(U_FUN, DEL), U_NP,           U_NP
)

ZMK_BASE_LAYER(U_EXTRA,
  &kp Q,             &kp W,          &kp E,              &kp R,              &kp T,                 &kp Y,            &kp U,             &kp I,            &kp O,            &kp P,                 \
  U_MTL(LGUI, A),    U_MTL(LALT, S), U_MTL(LCTRL, D),    U_MTL_f(LSHFT, F),  U_MTL(LGUI, G),        U_MTR(LGUI, H),   U_MTR_f(LSHFT, J), U_MTR(LCTRL, K),  U_MTR(LALT, L),   U_MTR(LGUI, SQT),       \
  U_LT(U_BUTTON, Z), U_MTL_f(RALT, X), &kp C,              &kp V,              &kp B,                 &kp N,            &kp M,             &kp COMMA,        U_MTR_f(RALT, DOT), U_LT(U_BUTTON, SLASH), \
  U_NP,              U_NP,           U_LT(U_MEDIA, ESC), U_LT(U_NAV, SPACE), U_LT(U_MOUSE, TAB),    U_LT(U_SYM, RET), U_LT(U_NUM, BSPC), U_LT(U_FUN, DEL), U_NP,             U_NP
)

ZMK_BASE_LAYER(U_TAP,
  U_NP,     &u_to_U_TAP, &u_to_U_EXTRA, &u_to_U_BASE, &u_to_U_ALT,                                  U_RDO,    U_PST,     U_CPY,     U_CUT,     U_UND,   \
  &kp LGUI, &kp LALT,    &kp LCTRL,     &kp LSHFT,    &kp LGUI,                                     &kp LEFT, &kp DOWN,  &kp UP,    &kp RIGHT, &caps,   \
  U_NA,     &kp RALT,    &u_to_U_NUM,   &u_to_U_NAV,  U_NA,                                         &kp HOME, &kp PG_DN, &kp PG_UP, &kp END,   &kp INS, \
  U_NP,     U_NP,        U_NA,          U_NA,         U_NA,                                         &kp RET,  &kp BSPC,  &kp DEL,   U_NP,      U_NP
)

ZMK_BASE_LAYER(U_BUTTON,
  U_NP,     &u_to_U_TAP, &u_to_U_EXTRA, &u_to_U_BASE, &u_to_U_ALT,                                  U_RDO,    U_PST,     U_CPY,     U_CUT,     U_UND,   \
  &kp LGUI, &kp LALT,    &kp LCTRL,     &kp LSHFT,    &kp LGUI,                                     &kp LEFT, &kp DOWN,  &kp UP,    &kp RIGHT, &caps,   \
  U_NA,     &kp RALT,    &u_to_U_NUM,   &u_to_U_NAV,  U_NA,                                         &kp HOME, &kp PG_DN, &kp PG_UP, &kp END,   &kp INS, \
  U_NP,     U_NP,        U_NA,          U_NA,         U_NA,                                         &kp RET,  &kp BSPC,  &kp DEL,   U_NP,      U_NP
)

ZMK_BASE_LAYER(U_NAV,
  U_NP,     &u_to_U_TAP, &u_to_U_EXTRA, &u_to_U_BASE, &u_to_U_ALT,                                  U_RDO,    U_PST,     U_CPY,     U_CUT,     U_UND,   \
  &kp LGUI, &kp LALT,    &kp LCTRL,     &kp LSHFT,    &kp LGUI,                                     &kp LEFT, &kp DOWN,  &kp UP,    &kp RIGHT, &caps,   \
  U_NA,     &kp RALT,    &u_to_U_NUM,   &u_to_U_NAV,  U_NA,                                         &kp HOME, &kp PG_DN, &kp PG_UP, &kp END,   &kp INS, \
  U_NP,     U_NP,        U_NA,          U_NA,         U_NA,                                         &kp RET,  &kp BSPC,  &kp DEL,   U_NP,      U_NP
)

ZMK_BASE_LAYER(U_MOUSE,
  U_NP,     &u_to_U_TAP, &u_to_U_EXTRA, &u_to_U_BASE,  U_NA,                                        U_RDO,  U_PST,  U_CPY,  U_CUT,  U_UND,   \
  &kp LGUI, &kp LALT,    &kp LCTL,      &kp LSHFT,     &kp LGUI,                                    U_MS_L, U_MS_D, U_MS_U, U_MS_R, &kp ESC, \
  U_NA,     &kp RALT,    &u_to_U_SYM,   &u_to_U_MOUSE, U_NA,                                        U_WH_L, U_WH_D, U_WH_U, U_WH_R, U_NU,    \
  U_NP,     U_NP,        U_NA,          U_NA,          U_NA,                                        U_BTN2, U_BTN1, U_BTN3, U_NP,   U_NP
)
ZMK_BASE_LAYER(U_MEDIA,
  U_BOOT,   &u_to_U_TAP, &u_to_U_EXTRA, &u_to_U_BASE,  U_NA,                                        U_RGB_EFF,   U_RGB_HUI,    U_RGB_SAI,    U_RGB_BRI,   U_RGB_TOG,  \
  &kp LGUI, &kp LALT,    &kp LCTRL,     &kp LSHFT,     &kp LGUI,                                    &kp C_PREV,  &kp C_VOL_DN, &kp C_VOL_UP, &kp C_NEXT,  U_EP_TOG,   \
  U_NA,     &kp RALT,    &u_to_U_FUN,   &u_to_U_MEDIA, U_NA,                                        &u_bt_sel_0, &u_bt_sel_1,  &u_bt_sel_2,  &u_bt_sel_3, &u_out_tog, \
  U_NP,     U_NP,        U_NA,          U_NA,          U_NA,                                        &kp C_STOP,  &kp C_PP,     &kp C_MUTE,   U_NP,        U_NP
)
ZMK_BASE_LAYER(U_NUM,
  &kp LBKT,  &kp N7, &kp N8,  &kp N9, &kp RBKT,                                                     U_NA,      &u_to_U_BASE, &u_to_U_EXTRA, &u_to_U_TAP, U_NP,     \
  &kp SEMI,  &kp N4, &kp N5,  &kp N6, &kp EQUAL,                                                    &kp LGUI,  &kp LSHFT,    &kp LCTRL,     &kp LALT,    &kp LGUI, \
  &kp GRAVE, &kp N1, &kp N2,  &kp N3, &kp BSLH,                                                     &kp COMMA, &u_to_U_NUM,  &u_to_U_NAV,   &kp RALT,    &kp DOT,  \
  U_NP,      U_NP,   &kp DOT, &kp N0, &kp MINUS,                                                    U_NA,      U_NA,         U_NA,          U_NP,        U_NP
)
ZMK_BASE_LAYER(U_SYM,
  &kp LBRC,  &kp AMPS, &kp ASTRK, &kp LPAR,  &kp RBRC,                                              U_NA,     &u_to_U_BASE, &u_to_U_EXTRA, &u_to_U_TAP, U_NP,     \
  &kp COLON, &kp DLLR, &kp PRCNT, &kp CARET, &kp PLUS,                                              &kp LGUI, &kp LSHFT,    &kp LCTRL,     &kp LALT,    &kp LGUI, \
  &kp TILDE, &kp EXCL, &kp AT,    &kp HASH,  &kp PIPE,                                              U_NA,     &u_to_U_SYM,  &u_to_U_MOUSE, &kp RALT,    U_NA,     \
  U_NP,      U_NP,     &kp LPAR,  &kp RPAR,  &kp UNDER,                                             U_NA,     U_NA,         U_NA,          U_NP,        U_NP
)
ZMK_BASE_LAYER(U_FUN,
  &kp F12, &kp F7, &kp F8,    &kp F9,    &kp PSCRN,                                                 U_NA,     &u_to_U_BASE, &u_to_U_EXTRA, &u_to_U_TAP, U_BOOT,   \
  &kp F11, &kp F4, &kp F5,    &kp F6,    &kp SLCK,                                                  &kp LGUI, &kp LSHFT,    &kp LCTRL,     &kp LALT,    &kp LGUI, \
  &kp F10, &kp F1, &kp F2,    &kp F3,    &kp PAUSE_BREAK,                                           U_NA,     &u_to_U_FUN,  &u_to_U_MEDIA, &kp RALT,    U_NA,     \
  U_NP,    U_NP,   &kp K_APP, &kp SPACE, &kp TAB,                                                   U_NA,     U_NA,         U_NA,          U_NP,        U_NP
)
