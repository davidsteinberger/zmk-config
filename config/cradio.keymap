#pragma once

#define ZMK_BASE_LAYER( \
  name, \
  K00, K01, K02, K03, K04,    K05, K06, K07, K08, K09, \
  K10, K11, K12, K13, K14,    K15, K16, K17, K18, K19, \
  K20, K21, K22, K23, K24,    K25, K26, K27, K28, K29, \
  K30, K31, K32, K33, K34,    K35, K36, K37, K38, K39  \
) \
  ZMK_LAYER( \
    name, \
    K00  K01  K02  K03  K04     K05  K06  K07  K08  K09 \
    K10  K11  K12  K13  K14     K15  K16  K17  K18  K19 \
    K20  K21  K22  K23  K24     K25  K26  K27  K28  K29 \
                   K33  K34     K35  K36                \
)

#include "zmk-helpers/key-labels/34.h"
#include "custom.keymap"

ZMK_COMBO(pdot_comma_qmark, &comma_qmark, RB1 RB2, U_BASE U_ALT )
ZMK_COMBO(sk_shift, &sk LSHFT, RH1 RB2, U_BASE U_ALT )
ZMK_COMBO(ip, &ip, LH1 LT2 RM4, U_BASE U_ALT)
ZMK_COMBO(ep, &ep, LH1 LT2 RM3, U_BASE U_ALT)
ZMK_COMBO(iw, &iw, LH1 LT1 RM4, U_BASE U_ALT)
ZMK_COMBO(ew, &ew, LH1 LT1 RM3, U_BASE U_ALT)
ZMK_COMBO(i,  &i, RH1 RB4, U_BASE U_ALT)

ZMK_COMBO(kc_esc, &lt U_MEDIA ESC, LH1 LH0, U_BASE U_EXTRA)
ZMK_COMBO(kc_dot, &kp DOT, LH1 LH0, U_NUM)
ZMK_COMBO(kc_lpar, &kp LPAR, LH1 LH0, U_SYM)
ZMK_COMBO(kc_rpar, &kp K_APP, LH1 LH0, U_FUN)

ZMK_COMBO(kc_del, &lt U_FUN DEL, RH1 RH0, U_BASE U_EXTRA)
ZMK_COMBO(kc_nav, &kp DEL, RH1 RH0, U_NAV)
ZMK_COMBO(kc_btn3, U_BTN3, RH1 RH0, U_MOUSE)
ZMK_COMBO(kc_mute, &kp C_MUTE, RH1 RH0, U_MEDIA)

